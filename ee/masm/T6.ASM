DSEG SEGMENT 
ADDOP DW 2 DUP(?) 
ADDOP1 DD ? 
JIA  DB   '+','$' 
DENGYU DB   '=','$' 
TEN    DW   10 
SUM  DD ? 
MES1     DB 'PLEASE INPUT TWO NUMBER: $' 
MES2     DB  'THE SUM IS: $' 
WRONG  DB  'THE NUMBER YOU INPUT IS NOT RIGHT, MUST < 10000 D, PLEASE INPUT AGAIN! $' 
DSEG ENDS 

ESEG SEGMENT 
ADDOP2 DD ? 
ESEG ENDS 

STACK  SEGMENT PARA STACK 'STACK' 
DB   100   DUP(?) 
STACK ENDS 

CODE SEGMENT 
ASSUME DS:DSEG,CS:CODE,ES:ESEG 
START: MOV AX,DSEG 
MOV DS,AX 
MOV AX,ESEG 
MOV ES,AX 
TS:  MOV SI,0 
MOV   CX,2         
LEA   DX,   MES1         
MOV   AH,   09 
INT       21H ;显示提示语    
AGAIN:  PUSH  CX 
CALL   INPUT ;输入
CMP AX,10000D ;最大限制
JL RIGHT 
POP CX 
CALL CRLF ;换行回车
MOV DX,OFFSET WRONG 
MOV AH,09H 
INT 21H ;报错
CALL CRLF ;换行回车
JMP TS 
RIGHT:  MOV   ADDOP[SI],AX 
INC   SI 
INC   SI 
POP   CX 
LOOP    AGAIN ;继续高字
CALL  CRLF 
LEA   DX,   MES2           
MOV   AH,   09 
INT       21H 
MOV SI,0 
MOV BX,ADDOP[SI] 
MOV WORD PTR ADDOP1,BX ;被加数
MOV WORD PTR ADDOP1+2,0 
INC SI 
INC SI 
MOV BX,ADDOP[SI] 
MOV WORD PTR ADDOP2,BX ;加数
MOV WORD PTR ADDOP2+2,0 
PUSH AX 
MOV AX,WORD PTR ADDOP1 
ADD AX,WORD PTR ADDOP2 
MOV WORD PTR SUM,AX 
MOV AX,WORD PTR ADDOP1+2 
ADC AX,WORD PTR ADDOP2+2 
MOV WORD PTR SUM+2,AX 
POP AX 
MOV BX,WORD PTR ADDOP1+2 ;显示被加数
CALL DISPLAY 
MOV BX,WORD PTR ADDOP1 
CALL DISPLAY 
MOV AH,09H 
MOV DX,OFFSET JIA ;显示加号
INT 21H 
MOV BX,WORD PTR ADDOP2+2 ;显示加数
CALL DISPLAY 
MOV BX,WORD PTR ADDOP2 
CALL DISPLAY 
MOV AH,09H 
MOV DX,OFFSET DENGYU ;显示等于号
INT 21H 
MOV BX,WORD PTR SUM+2 ;显示结果
CALL DISPLAY 
MOV BX,WORD PTR SUM 
CALL DISPLAY 
MOV AH,4CH 
INT 21H 

CRLF PROC NEAR ;换行回车
MOV   DL,0AH      
MOV   AH,02H 
INT   21H 
MOV   DL,0DH    
MOV   AH,02H    
INT   21H 
RET 
CRLF ENDP 

INPUT   PROC   NEAR ;输入加数被加数 
MOV   AX,0 
PUSH   AX 
AGAIN1: MOV AH,01H                     
INT   21H ;键盘输入回显
CMP AL,30H                     
JL   EXIT 
CMP   AL,39H 
JG   EXIT 
SUB   AL,30H                   
MOV   BL,AL 
MOV   BH,0 
POP   AX 
CWD 
IMUL   TEN                     
ADD   AX,BX 
PUSH   AX 
JMP   AGAIN1 
EXIT: POP   AX 
RET 
INPUT   ENDP 
DISPLAY PROC NEAR 
MOV CX,10000D     
CALL DEC_DIV 
MOV CX,1000D      
CALL DEC_DIV 
MOV CX,100D     
CALL DEC_DIV 
MOV CX,10D       
CALL DEC_DIV 
MOV CX,1D       
CALL DEC_DIV 
RET       
DEC_DIV PROC NEAR    
MOV AX,BX        
MOV DX,0       
DIV CX       
MOV BX,DX       
MOV DL,AL       
ADD DL,30H      
MOV AH,2H 
INT 21H       
RET         
DEC_DIV ENDP 
DISPLAY ENDP 
CODE  ENDS 
END START 